## packaging/yocto/meta-xlui/conf/layer.conf
```bitbake
BBPATH .= ":${LAYERDIR}"
BBFILES += "${LAYERDIR}/recipes-*/*/*.bb"
BBFILE_COLLECTIONS += "xlui"
BBFILE_PATTERN_xlui = "^${LAYERDIR}/"
BBFILE_PRIORITY_xlui = "6"
LAYERDEPENDS_xlui = "core"
LAYERSERIES_COMPAT_xlui = "wrynose"
```
